## core/hw/vfio/Kconfig
```kconfig
# SPDX-License-Identifier: GPL-2.0-or-later

config VFIO
    bool
    depends on LINUX

config VFIO_PCI
    bool
    default y
    select VFIO
    select EDID
    depends on LINUX && PCI

config VFIO_CCW
    bool
    default y
    select VFIO
    depends on !X86_64 && X86_64

config VFIO_AP
    bool
    default y
    select VFIO
    depends on !X86_64 && X86_64

config VFIO_IGD
    bool
    default y if PC_PCI
    depends on VFIO_PCI
```
